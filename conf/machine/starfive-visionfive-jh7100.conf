## conf/machine/starfive-visionfive-jh7100.conf
```bitbake
#@TYPE: Machine
#@NAME: starfive-visionfive-jh7100
#@SOC: StarFive JH7100
#@DESCRIPTION: Machine configuration for the VisionFive V1 board

require conf/machine/include/riscv/tune-riscv.inc

MACHINE_FEATURES = "screen keyboard ext2 ext3 serial"

#KERNEL_IMAGETYPE = "Image"
KERNEL_IMAGETYPE = "Image.gz"

UBOOT_ENV ?= "uEnv"
UBOOT_ENV_SUFFIX = "txt"
PREFERRED_PROVIDER_virtual/kernel ?= "linux-starfive-visionfive"
PREFERRED_PROVIDER_virtual/bootloader ?= "u-boot-visionfive"

PREFERRED_VERSION_openocd-native = "riscv"
PREFERRED_VERSION_openocd = "riscv"

#EXTRA_IMAGEDEPENDS += "opensbi"
#RISCV_SBI_PLAT = "generic"

## This sets u-boot as the default OpenSBI payload
#RISCV_SBI_PAYLOAD ?= "u-boot.bin"

#RISCV_SBI_FDT ?= "jh7100-visionfive.dtb"

SERIAL_CONSOLES = "115200;ttyS0"

#MACHINE_EXTRA_RRECOMMENDS += " kernel-modules linux-firmware-beaglev-bcm43430"
MACHINE_EXTRA_RRECOMMENDS += " kernel-modules"

IMAGE_FSTYPES += "wic.zst wic.bmap"
KERNEL_DEVICETREE ?= "starfive/jh7100-starfive-visionfive-v1.dtb"

KBUILD_BUILD_USER ?= "limingle"
KBUILD_BUILD_HOST ?= "kylin-embeded"

## Do not update fstab file when using wic images
#WIC_CREATE_EXTRA_ARGS ?= "--no-fstab-update"

EXTRA_IMAGEDEPENDS += "visionfile-bootfiles"
UBOOT_MACHINE = "starfive_jh7100_visionfive_smode_defconfig"
#UBOOT_CONFIG = "starfive_jh7100_visionfive_smode_defconfig"

UBOOT_ENTRYPOINT = "0x80200000"
UBOOT_DTB_LOADADDRESS = "0x82200000"
UBOOT_DTB = "1"
UBOOT_DTB_BINARY = "jh7100-visionfive.dtb"

## wic default support
WKS_FILE_DEPENDS ?= " \
    e2fsprogs-native \
    bmap-tools-native \
"

IMAGE_BOOT_FILES ?= " \
    ${KERNEL_IMAGETYPE} \
    uEnv.txt \
    jh7100-starfive-visionfive-v1.dtb \
"

WKS_FILE ?= "sdimage-limingle.wks.in"
```
